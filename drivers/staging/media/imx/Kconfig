## drivers/staging/media/imx/Kconfig
```kconfig
config VIDEO_IMX_MEDIA
	tristate "i.MX5/6 V4L2 media devices"
	depends on MEDIA_CONTROLLER && VIDEO_V4L2 && ARCH_MXC && IMX_IPUV3_CORE
	default y
	---help---
	  Say yes here to enable support for video4linux media controller
	  driver and subdevices for the i.MX5/6 SOC.

if VIDEO_IMX_MEDIA
menu "i.MX5/6 Media Sub devices"

config VIDEO_IMX_CAMERA
	tristate "i.MX5/6 Camera Interface driver"
	depends on VIDEO_IMX_MEDIA && VIDEO_DEV && I2C
	select VIDEOBUF2_DMA_CONTIG
	default y
	---help---
	  A video4linux camera interface driver for i.MX5/6 SOC.

config IMX_MIPI_CSI2
       tristate "MIPI CSI2 Receiver Driver"
       depends on VIDEO_IMX_CAMERA
       default y
       ---help---
         MIPI CSI-2 Receiver driver support. This driver is required
	 for sensor drivers with a MIPI CSI2 interface.

config IMX_VIDEO_SWITCH
	tristate "i.MX5/6 Video Bus Multiplexer"
	depends on GPIOLIB && VIDEO_IMX_CAMERA
	default y
	---help---
	  This driver provides support for the i.MX5/6 internal video bus
	  multiplexer controlled by register bitfields as well as
	  external multiplexers controller by a GPIO.

config IMX_OV5640_MIPI
       tristate "OmniVision OV5640 MIPI CSI-2 camera support"
       depends on GPIOLIB && VIDEO_IMX_CAMERA
       select IMX_MIPI_CSI2
       default y
       ---help---
         MIPI CSI-2 OV5640 Camera support.

endmenu
endif
```
